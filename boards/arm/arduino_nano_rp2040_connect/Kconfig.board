## boards/arm/arduino_nano_rp2040_connect/Kconfig.board
```kconfig
# Copyright (c) 2023 Joep Buruma
# SPDX-License-Identifier: Apache-2.0

config BOARD_ARDUINO_NANO_RP2040_CONNECT
	bool "Arduino nano RP2040 connect"
	depends on SOC_RP2040
```

## boards/arm/arduino_nano_rp2040_connect/Kconfig.defconfig
```kconfig
# Copyright (c) 2021 Yonatan Schachter
# SPDX-License-Identifier: Apache-2.0

if BOARD_ARDUINO_NANO_RP2040_CONNECT

config BOARD
	default "arduino_nano_rp2040_connect"

config RP2_FLASH_AT25SF128A
	default y

if I2C_DW

config I2C_DW_CLOCK_SPEED
	default 100

endif #I2C_DW

endif # BOARD_RPI_PICO
```

## drivers/dma/Kconfig.rpi_pico
```kconfig
config DMA_RPI_PICO
    bool "RPI pico dma controller"
    default y
    depends on SOC_FAMILY_RPI_PICO
    select PICOSDK_USE_DMA
```

## drivers/pwm/Kconfig.rpi_pico
```kconfig
# Copyright (c) 2022, Joep Buruma
# SPDX-License-Identifier: Apache-2.0

config PWM_RPI_PICO
    bool "RP2040 PWM"
    default y
    select PICOSDK_USE_PWM
    help
      Enable PWM driver for RP2040 MCU
```

## drivers/pwm/Kconfig.rpi_pico_slice
```kconfig
# Copyright (c) 2022, Joep Buruma
# SPDX-License-Identifier: Apache-2.0

config PWM_RPI_PICO
    bool "RP2040 PWM"
		default y
		depends on SOC_SERIES_RP2XXX
    select PICOSDK_USE_PWM
    help
      Enable PWM driver for RP2040 MCU
```

## drivers/sensor/scd30/Kconfig
```kconfig
# Sensirion SCD30 CO2 sensor configuration options

# Copyright (c) 2016 Advanced Climate Systems
# SPDX-License-Identifier: Apache-2.0

menuconfig SCD30
    depends on I2C
    select SENSIRION_COMMON
    bool "Sensirion SCD30 CO2 Sensor"
    default false

if SCD30

comment "SCD30 Options"

config SCD30_MEASUREMENT_INTERVAL
    int "measurement interval in seconds"
    default 30
    range 2 1800
    help
      The interval with wich measurement are done.
      Has to be in the range [2; 1800].

module = SCD30
module-str = sensirion-scd30
source "subsys/logging/Kconfig.template.log_config"

endif
```

## dts/bindings/dma/raspberrypi,pico-dmac.yaml
```yaml
description: Raspberry Pi RP2 series DMA controller

compatible: "raspberrypi,pico-dmac"

include: [dma-controller.yaml, reset-device.yaml]

properties:
    reg:
      required: true

    interrupts:
      required: true

    "#dma-cells":
      const: 2

dma-cells:
  - channel
  - trigger-src
```

## dts/bindings/pwm/raspberrypi,pico-pwm-slice.yaml
```yaml
# Copyright (c) 2022, Joep Buruma
# SPDX-License-Identifier: Apache-2.0

description: Raspberry Pi Pico PWM

compatible: "raspberrypi,pico-pwm-slice"

include: [pwm-controller.yaml, pinctrl-device.yaml, base.yaml]

properties:
    "#pwm-cells":
      const: 2

    divider-int:
      type: int
      required: false
      default: 1
      description: |
        The integral part of the divider for the pwm slice.
        This number should be in the range 1 - 255.
    
    divider-frac:
      type: int
      required: false
      default: 0
      description: |
        The fractional part of the divider for the pwm slice.
        This number should be in the range 0 - 15.


pwm-cells:
  - channel
  - flags
```

## dts/bindings/pwm/raspberrypi,pico-pwm.yaml
```yaml
# Copyright (c) 2022, Joep Buruma
# SPDX-License-Identifier: Apache-2.0

description: Raspberry Pi Pico PWM

compatible: "raspberrypi,pico-pwm"

include: [base.yaml]

properties:
    reg:
      required: true

    interrupts:
      required: true
```

## dts/bindings/sensor/sensirion,scd30.yaml
```yaml
# Copyright (c) 2021, Advanced Climate Systems
# SPDX-License-Identifier: Apache-2.0
description: Sensirion SCD30 C02 Sensor

compatible: "sensirion,scd30"

include: i2c-device.yaml

properties:
    label:
      required: true
```

## soc/arm/raspberrypi_rp2/Kconfig
```kconfig
# Raspberry Pi Foundation RP2XXX family configuration options

# Copyright (c) 2017 Google LLC.
# SPDX-License-Identifier: Apache-2.0

config SOC_FAMILY_RP2
	bool
	help
		"support for the RP2 dual core arm MCU"

config SOC_FAMILY
	string
	default "raspberrypi_rp2" if SOC_FAMILY_RP2

config SOC_SERIES
	string
	default "rp20" if SOC_SERIES_RP20

# Raspberry Pi Foundation RP2 series

# SPDX-License-Identifier: Apache-2.0
```

## soc/arm/raspberrypi_rp2/Kconfig.defconfig
```kconfig
# Atmel SAM0 MCU family default configuration options

# Copyright (c) 2017 Google LLC.
# SPDX-License-Identifier: Apache-2.0

source "soc/arm/raspberrypi_rp2/rp20/Kconfig.defconfig.series"
```

## soc/arm/raspberrypi_rp2/Kconfig.soc
```kconfig
# Atmel SAM0 MCU series selection

# Copyright (c) 2017 Google LLC.
# SPDX-License-Identifier: Apache-2.0

# Included under "SoC/CPU/Configuration Selection"

source "soc/arm/raspberrypi_rp2/rp20/Kconfig.series"

choice 
	prompt "RP20 Series MCU selection"
	depends on SOC_SERIES_RP20

config SOC_PART_NUMBER_RP2040
	bool "RP2040"

endchoice
```

## soc/arm/raspberrypi_rp2/rp20/Kconfig.defconfig.rp2040
```kconfig
if SOC_PART_NUMBER_RP2040

config SOC
	default "rp2040"

config NUM_IRQS
	default 26

config SYS_CLOCK_HW_CYCLES_PER_SEC
	default 125000000


endif
```

## soc/arm/raspberrypi_rp2/rp20/Kconfig.defconfig.series
```kconfig
if SOC_SERIES_RP20

config SOC_SERIES
	default "rp20"



if GPIO

config GPIO_RP20
	bool
	default y

endif # GPIO

source "soc/arm/raspberrypi_rp2/rp20/Kconfig.defconfig.rp2040"

endif # SOC_SERIES_RP20
```

## soc/arm/raspberrypi_rp2/rp20/Kconfig.series
```kconfig
# Hardware Series selection, Included by 
config SOC_SERIES_RP20
	bool "Raspberry Pi RP20 Series MCU"
	select SOC_FAMILY_RP2
	select ARM
	select CPU_CORTEX_M0PLUS
	select CPU_CORTEX_M_HAS_SYSTICK
	select CPU_CORTEX_M_HAS_VTOR
	help
		Enable support for RP20 Series MCU


if SOC_SERIES_RP20

source "soc/arm/raspberrypi_rp2/rp20/Kconfig.defconfig.rp2040"

endif
```

## soc/arm/raspberrypi_rp2/rp20/Kconfig.soc
```kconfig
# SPDX-License-Identifier: Apache-2.0

source "soc/arm/raspberrypi_rp2/rp20/Kconfig.defconfig.series"
```
